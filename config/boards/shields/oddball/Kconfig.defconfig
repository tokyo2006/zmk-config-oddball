## config/boards/shields/oddball/Kconfig.defconfig
```kconfig
if SHIELD_ODDBALL_CENTRAL_DONGLE || SHIELD_ODDBALL_CENTRAL_LEFT

config ZMK_KEYBOARD_NAME
    default "Oddball"

config ZMK_SPLIT_ROLE_CENTRAL
    default y

endif

if ZMK_DISPLAY

config I2C
    default y

choice ZMK_DISPLAY_WORK_QUEUE
    default ZMK_DISPLAY_WORK_QUEUE_DEDICATED
endchoice

endif



if SHIELD_ODDBALL_CENTRAL_DONGLE || SHIELD_ODDBALL_CENTRAL_LEFT || SHIELD_ODDBALL_PERIPHERAL_LEFT || SHIELD_ODDBALL_PERIPHERAL_RIGHT

config ZMK_SPLIT
    default y

endif

config MOUSE_LAYER_INDEX
	int "Index of mouse layer"
	default 4

config SCROLL_LAYER_INDEX
	int "Index of scroll layer"
	default 5

config MOUSE_LAYER_ACTIVE_MS
	int "Amount of milliseconds the mouse layer will be active after using the trackball"
	default 400
```

## config/boards/shields/oddball/Kconfig.shield
```kconfig
# Copyright (c) 2020 The ZMK Contributors
# SPDX-License-Identifier: MIT

config SHIELD_ODDBALL_CENTRAL_DONGLE
    def_bool $(shields_list_contains,oddball_central_dongle)

config SHIELD_ODDBALL_PERIPHERAL_LEFT
    def_bool $(shields_list_contains,oddball_peripheral_left)

config SHIELD_ODDBALL_PERIPHERAL_RIGHT
    def_bool $(shields_list_contains,oddball_peripheral_right)
```

## config/west.yml
```yaml
manifest:
  remotes:
    - name: zmkfirmware
      url-base: https://github.com/petejohanson
    - name: badjeff
      url-base: https://github.com/badjeff
    - name: tokyo2006
      url-base: https://github.com/tokyo2006
  projects:
    - name: zmk
      remote: zmkfirmware
      revision: feat/pointers-move-scroll
      import: app/west.yml
    - name: zmk-pmw3610-driver
      remote: badjeff
      revision: main
    - name: zmk-split-peripheral-input-relay
      remote: badjeff
      revision: main
    - name: zmk-input-behavior-listener
      remote: badjeff
      revision: main
    - name: prospector-zmk-module
      remote: tokyo2006
      revision: main
  self:
    path: config
```
